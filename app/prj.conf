## CMakeLists.txt
```
cmake_minimum_required(VERSION 3.20.5)

find_package(Zephyr REQUIRED HINTS $ENV{ZEPHYR_BASE})
project(zephyr_hello)

set(COMMON_DIR ${CMAKE_CURRENT_SOURCE_DIR}/../src/common)
target_include_directories(app PRIVATE ${COMMON_DIR}/greet)
target_sources(app PRIVATE
    src/main.c
    ${COMMON_DIR}/greet/greet.c
)
```

## prj.conf
```kconfig
CONFIG_PRINTK=y
CONFIG_LOG=y
CONFIG_LOG_DEFAULT_LEVEL=3
```

## src/main.c
```c
#include <zephyr/kernel.h>
#include <zephyr/sys/printk.h>

#include "greet.h"

int main(void)
{
	char buf[64];

	if (greet(CONFIG_BOARD, buf, sizeof(buf)) > 0) {
		printk("%s\n", buf);
	}

	uint32_t tick = 0;
	while (1) {
		printk("tick %u\n", tick++);
		k_msleep(1000);
	}

	return 0;
}
```
