## CMakeLists.txt
```
cmake_minimum_required(VERSION 3.20.5)
# Host-compiled unit test: no kernel, no board, output is a plain x86 ELF.
find_package(Zephyr COMPONENTS unittest REQUIRED HINTS $ENV{ZEPHYR_BASE})
project(test_greet)

set(MODULE_DIR ${CMAKE_CURRENT_SOURCE_DIR}/../../../src/common/greet)
target_include_directories(testbinary PRIVATE ${MODULE_DIR})
target_sources(testbinary PRIVATE
    ${MODULE_DIR}/greet.c
    src/test_greet.c
)

# Rename the executable on disk. TEST_TARGET is passed by the top-level
# tests/CMakeLists.txt; fall back to a sensible default for direct cmake.
if(NOT DEFINED TEST_TARGET)
    set(TEST_TARGET ztest_common_greet)
endif()
set_target_properties(testbinary PROPERTIES OUTPUT_NAME ${TEST_TARGET})
```

## prj.conf
```kconfig
# prj.conf is required by Zephyr's unittest module even though no Kconfig
# is processed in COMPONENTS unittest mode. Keep empty.
```

## src/test_greet.c
```c
#include <zephyr/ztest.h>
#include <string.h>

#include "greet.h"

ZTEST_SUITE(greet_suite, NULL, NULL, NULL, NULL, NULL);

ZTEST(greet_suite, formats_basic_name)
{
	char buf[32];
	int n = greet("Zephyr", buf, sizeof(buf));

	zassert_equal(n, 14, "wrote %d bytes, expected 14", n);
	zassert_str_equal(buf, "Hello, Zephyr!");
}

ZTEST(greet_suite, rejects_null_name)
{
	char buf[32];
	zassert_equal(greet(NULL, buf, sizeof(buf)), -1);
}

ZTEST(greet_suite, rejects_null_buffer)
{
	zassert_equal(greet("x", NULL, 32), -1);
}

ZTEST(greet_suite, rejects_undersized_buffer)
{
	char buf[4];
	int n = greet("World", buf, sizeof(buf));
	zassert_equal(n, -1, "should reject truncation, got %d", n);
}
```
